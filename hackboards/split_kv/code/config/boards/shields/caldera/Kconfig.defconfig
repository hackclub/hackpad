## hackboards/split_kv/code/config/boards/shields/caldera/Kconfig.defconfig
```kconfig
if SHIELD_SPLITKV_LEFT

config ZMK_KEYBOARD_NAME
    default "splitKV"

config ZMK_SPLIT_ROLE_CENTRAL
    default y

endif

if SHIELD_SPLITKV_LEFT || SHIELD_SPLITKV_RIGHT

config ZMK_SPLIT
    default y

endif
```

## hackboards/split_kv/code/config/boards/shields/caldera/Kconfig.shield
```kconfig
config SHIELD_SPLITKV_LEFT
    def_bool $(shields_list_contains,splitKV_left)

config SHIELD_SPLITKV_RIGHT
    def_bool $(shields_list_contains,splitKV_right)
```
